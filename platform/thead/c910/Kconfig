## platform/thead/c910/Kconfig
```kconfig
# SPDX-License-Identifier: BSD-2-Clause

config PLATFORM_THEAD_C910
	bool
	select IPI_MSWI
	select IRQCHIP_PLIC
	select SERIAL_UART8250
	select TIMER_MTIMER
	default y
```
